#include <avr/io.h>
#include <util/delay.h>

// ****************************************************************

  int vStat=0;  // Состояние света: 0 - выключено, 1 - включено
  int vTimer=0; // Счетчик таймера
  int vLimit=100; // Предел таймера, его максимальное значение в секундах (сколько горит свет)

// ****************************************************************

/* * * * * * * * * * * * * * * * * * * * * * * * * * * * * * * * * * * *
 * Пoрт PB4 у нас выход - на него вешаем транзистор/реле
 * Пoрт PB2 у нас вход  - на него вешаем транзистор/реле
 * 
 * * * * * * * * * * * * * * * * * * * * * * * * * * * * * * * * * * * */

int main( void )
{
  DDRB |= _BV (4); // pinMode (4, OUTPUT);
  // или как вариант:
  // DDRB=0x10;       // устанавливаем вывод PB4 как выход, 
                   // 0x10 в шестнадцатиричной == 0b10000 в двоичной записи, где крайний правый - порт PB0
                   // При этом 0 - ввод (PINBx), 1 - вывод (PORTBx)
                   
  PORTB=0x02;      // по тому же принципу настраиваем уровень (включаем подтягивающий резистор на порту PB1)
                   // 0x02 в шестнадцатиричной == 0b00010 в двоичной записи, где крайний правый - порт PB0
                   // Т.е. уровень: 
                   //     для ВЫХОДА: 0 - низкий уровень (выключено),   1 - высокий (включено)
                   //     для ВХОДА:  0 - без подтягивающего резистора, 1 - с подтягивающим резистором
                  
  while(1){        // основной цикл (структура другая, loop нету жеж)
    if(vStat==1){     // Если свет включен
      while(vTimer < vLimit){
          if(PINB & (1 << PINB2)){        // if(digitalRead(2) == HIGH)
            PORTB |= (1<<4);   // включаем свет (устанавливаем высокий уровень на выводе PB4)
            vStat = 1;         // переключаем статус на включено.
          }
        vTimer +=1;
        _delay_ms(1);       // ждем 100 миллисекунд
        PORTB &= ~(1<<4);   // устанавливаем низкий уровень на выводе PB4
        _delay_ms(1);       // ждем 100 миллисекунд
        PORTB |= (1<<4);     // устанавливаем высокий уровень на выводе PB4
      }
//    if(vTimer == vLimit){  // Если таймер достиг своего предела
        vStat = 0;        // сбросим состояние
        vTimer = 0;       // сбросим таймер
        PORTB &= ~(1<<4); // выключаем свет (устанавливаем низкий уровень на выводе PB4)
        _delay_ms(100);       // ждем 100 миллисекунд
//      }
    } else {       // иначе ждем "нажатия кнопки" (датчик дожен сработать)
      if(PINB & (1 << PINB2)){        // if(digitalRead(2) == HIGH)
        PORTB |= (1<<4);   // включаем свет (устанавливаем высокий уровень на выводе PB4)
        vStat = 1;         // переключаем статус на включено.
      }
    }
  }
  return 0; // main почему-то нельзя сделать void, приходится возвращать хоть что-то, хотя оно и не нужно )
}

void beep(void)
{

}
